## config/boards/shields/corne_antar/Kconfig.shield
```kconfig
# Copyright (c) 2020 Pete Johanson
# SPDX-License-Identifier: MIT

config SHIELD_CORNE_ANTAR_LEFT
    def_bool $(shields_list_contains,corne_antar_left)

config SHIELD_CORNE_ANTAR_RIGHT
    def_bool $(shields_list_contains,corne_antar_right)
```
